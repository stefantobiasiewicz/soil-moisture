## boards/OpenCoded/st_soil_sensor_52840/Kconfig.defconfig
```kconfig
if BOARD_ST_SOIL_SENSOR_52840

config BT_CTLR
	default BT

endif # BOARD_ST_SOIL_SENSOR_52840
```

## boards/OpenCoded/st_soil_sensor_52840/board.yml
```yaml
board:
  name: st_soil_sensor_52840
  vendor: OpenCoded
  socs:
    - name: nrf52840
```

## boards/arm/st_soil_sensor_52833/Kconfig.board
```kconfig
# Copyright (c) 2024 Nordic Semiconductor ASA
# SPDX-License-Identifier: Apache-2.0

config BOARD_ST_SOIL_SENSOR_52833
	bool "st_soil_sensor_52833"
	depends on SOC_NRF52833_QIAA
```

## boards/arm/st_soil_sensor_52833/Kconfig.defconfig
```kconfig
# Copyright (c) 2024 Nordic Semiconductor ASA
# SPDX-License-Identifier: Apache-2.0

if BOARD_ST_SOIL_SENSOR_52833

config BOARD
	default "st_soil_sensor_52833"

config BT_CTLR
   default BT


endif
```
